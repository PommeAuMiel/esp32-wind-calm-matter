## firmware/WindCalmThreadSDK/sdkconfig.defaults
```kconfig
# Wind Calm dedicated SDK: ESP-IDF 5.5.5 / Arduino 3.3.12 / ESP-Matter 1.5.1.
# Compile-only preparation. Existing flash/NVS layout and accessory endpoint IDs stay.
# Inspect the generated sdkconfig: hidden symbols may ignore values in defaults.

CONFIG_IDF_TARGET="esp32c6"
CONFIG_ESPTOOLPY_FLASHSIZE_4MB=y
CONFIG_ESPTOOLPY_FLASHMODE_QIO=y
CONFIG_ESPTOOLPY_FLASHFREQ_80M=y
CONFIG_PARTITION_TABLE_CUSTOM=y
CONFIG_PARTITION_TABLE_CUSTOM_FILENAME="partitions.csv"
CONFIG_PARTITION_TABLE_OFFSET=0x8000

# Arduino / USB Serial-JTAG. CMake must also define ARDUINO_USB_MODE=1
# and ARDUINO_USB_CDC_ON_BOOT=1 for Arduino and the application.
CONFIG_AUTOSTART_ARDUINO=y
CONFIG_ARDUINO_VARIANT="XIAO_ESP32C6"
CONFIG_FREERTOS_HZ=1000
CONFIG_ARDUINO_RUN_CORE0=y
CONFIG_ARDUINO_LOOP_STACK_SIZE=8192
CONFIG_ARDUINO_EVENT_RUN_CORE0=y
CONFIG_ARDUINO_SERIAL_EVENT_RUN_CORE0=y
CONFIG_ARDUINO_SELECTIVE_COMPILATION=y
CONFIG_ARDUINO_SELECTIVE_Network=y
CONFIG_ARDUINO_SELECTIVE_Matter=y
CONFIG_ARDUINO_SELECTIVE_Preferences=y
CONFIG_ARDUINO_SELECTIVE_OpenThread=n
CONFIG_ARDUINO_SELECTIVE_USB=n
CONFIG_ARDUINO_SELECTIVE_ArduinoOTA=n
CONFIG_ARDUINO_SELECTIVE_AsyncUDP=n
CONFIG_ARDUINO_SELECTIVE_BLE=n
CONFIG_ARDUINO_SELECTIVE_BluetoothSerial=n
CONFIG_ARDUINO_SELECTIVE_Console=n
CONFIG_ARDUINO_SELECTIVE_DNSServer=n
CONFIG_ARDUINO_SELECTIVE_EEPROM=n
CONFIG_ARDUINO_SELECTIVE_ESP_I2S=n
CONFIG_ARDUINO_SELECTIVE_ESP_NOW=n
CONFIG_ARDUINO_SELECTIVE_ESP_SR=n
CONFIG_ARDUINO_SELECTIVE_ESP_HostedOTA=n
CONFIG_ARDUINO_SELECTIVE_ESP_Video=n
CONFIG_ARDUINO_SELECTIVE_ESPmDNS=n
CONFIG_ARDUINO_SELECTIVE_Ethernet=n
CONFIG_ARDUINO_SELECTIVE_FFat=n
CONFIG_ARDUINO_SELECTIVE_FS=n
CONFIG_ARDUINO_SELECTIVE_Hash=n
CONFIG_ARDUINO_SELECTIVE_HTTPClient=n
CONFIG_ARDUINO_SELECTIVE_HTTPUpdate=n
CONFIG_ARDUINO_SELECTIVE_HTTPUpdateServer=n
CONFIG_ARDUINO_SELECTIVE_Insights=n
CONFIG_ARDUINO_SELECTIVE_LittleFS=n
CONFIG_ARDUINO_SELECTIVE_NetBIOS=n
CONFIG_ARDUINO_SELECTIVE_NetworkClientSecure=n
CONFIG_ARDUINO_SELECTIVE_PPP=n
CONFIG_ARDUINO_SELECTIVE_RainMaker=n
CONFIG_ARDUINO_SELECTIVE_SD=n
CONFIG_ARDUINO_SELECTIVE_SD_MMC=n
CONFIG_ARDUINO_SELECTIVE_SPI=n
CONFIG_ARDUINO_SELECTIVE_SPIFFS=n
CONFIG_ARDUINO_SELECTIVE_SimpleBLE=n
CONFIG_ARDUINO_SELECTIVE_Ticker=n
CONFIG_ARDUINO_SELECTIVE_Update=n
CONFIG_ARDUINO_SELECTIVE_WebServer=n
CONFIG_ARDUINO_SELECTIVE_WiFi=n
CONFIG_ARDUINO_SELECTIVE_WiFiProv=n
CONFIG_ARDUINO_SELECTIVE_Wire=n
CONFIG_ARDUINO_SELECTIVE_Zigbee=n
# Hidden default y in upstream Arduino: requires scoped Kconfig default override.
CONFIG_ENABLE_ARDUINO_DEPENDS=n
CONFIG_LWIP_SO_RCVBUF=y

# Size optimization retains runtime safety checks.
CONFIG_COMPILER_OPTIMIZATION_SIZE=y
CONFIG_COMPILER_CXX_EXCEPTIONS=n
CONFIG_COMPILER_CXX_RTTI=n
CONFIG_COMPILER_OPTIMIZATION_ASSERTIONS_SILENT=y
CONFIG_COMPILER_OPTIMIZATION_CHECKS_SILENT=y
CONFIG_COMPILER_STACK_CHECK_MODE_NORM=y
CONFIG_FREERTOS_CHECK_STACKOVERFLOW_CANARY=y
CONFIG_ESP_SYSTEM_PANIC_PRINT_REBOOT=y

# Preserve the deployed Arduino SDK's remaining IDF task/interrupt stacks.
CONFIG_ESP_MAIN_TASK_STACK_SIZE=4096
CONFIG_ESP_TIMER_TASK_STACK_SIZE=8192
CONFIG_ESP_IPC_TASK_STACK_SIZE=2048
CONFIG_FREERTOS_IDLE_TASK_STACKSIZE=2304
CONFIG_FREERTOS_ISR_STACKSIZE=2096
CONFIG_LWIP_TCPIP_TASK_STACK_SIZE=4096
CONFIG_BT_LE_CONTROLLER_TASK_STACK_SIZE=5120

# Matter uses Thread; no Wi-Fi commissioning driver or Wi-Fi telemetry.
# ESP_WIFI_ENABLED is hidden on this IDF version; do not claim this setting
# alone removes all Wi-Fi objects. Check the linked ELF/map for actual removal.
CONFIG_ENABLE_WIFI_STATION=n
CONFIG_ENABLE_WIFI_AP=n
CONFIG_WIFI_NETWORK_COMMISSIONING_DRIVER=n
CONFIG_ENABLE_WIFI_TELEMETRY=n
CONFIG_ENABLE_ETHERNET_TELEMETRY=n
CONFIG_ENABLE_MATTER_OVER_THREAD=y
CONFIG_THREAD_NETWORK_COMMISSIONING_DRIVER=y
CONFIG_THREAD_NETWORK_ENDPOINT_ID=0
CONFIG_CUSTOM_NETWORK_CONFIG=n
CONFIG_ESP_MATTER_ENABLE_OPENTHREAD=y
CONFIG_ESP_MATTER_ENABLE_DATA_MODEL=y
CONFIG_ESP_MATTER_ENABLE_MATTER_SERVER=y
CONFIG_ESP_MATTER_NVS_PART_NAME="nvs"
CONFIG_CHIP_FACTORY_NAMESPACE_PARTITION_LABEL="nvs"
CONFIG_CHIP_CONFIG_NAMESPACE_PARTITION_LABEL="nvs"
CONFIG_CHIP_COUNTERS_NAMESPACE_PARTITION_LABEL="nvs"
CONFIG_CHIP_KVS_NAMESPACE_PARTITION_LABEL="nvs"
CONFIG_ESP_MATTER_MAX_DEVICE_TYPE_COUNT=32
CONFIG_ESP_MATTER_MAX_DYNAMIC_ENDPOINT_COUNT=32
CONFIG_ESP_MATTER_MODE_SELECT_CLUSTER_ENDPOINT_COUNT=0
CONFIG_ESP_MATTER_BINDING_TABLE_SIZE=2
CONFIG_ESP_MATTER_SCENES_TABLE_SIZE=16
CONFIG_CHIP_TASK_STACK_SIZE=8192
CONFIG_THREAD_TASK_STACK_SIZE=5120
CONFIG_MAX_EVENT_QUEUE_SIZE=40
# Restore the deployed Thread SRP/DNS discovery path, not minimal multicast mDNS.
CONFIG_USE_MINIMAL_MDNS=n
CONFIG_ENABLE_OTA_REQUESTOR=n
CONFIG_ESP_MATTER_OTA_PROVIDER_ENABLED=n
CONFIG_CHIP_OTA_IMAGE_BUILD=n

# Native 802.15.4 / Thread router capability retained for first comparison.
CONFIG_OPENTHREAD_ENABLED=y
CONFIG_OPENTHREAD_FTD=y
CONFIG_OPENTHREAD_RADIO_NATIVE=y
CONFIG_OPENTHREAD_PLATFORM_NETIF=y
CONFIG_OPENTHREAD_SRP_CLIENT=y
CONFIG_OPENTHREAD_DNS_CLIENT=y
CONFIG_OPENTHREAD_CONSOLE_ENABLE=n
CONFIG_OPENTHREAD_CLI=n
CONFIG_OPENTHREAD_DIAG=n
CONFIG_OPENTHREAD_COMMISSIONER=n
CONFIG_OPENTHREAD_JOINER=y
CONFIG_OPENTHREAD_BORDER_ROUTER=n
CONFIG_OPENTHREAD_TASK_SIZE=8192
CONFIG_OPENTHREAD_NUM_MESSAGE_BUFFERS=65
CONFIG_LWIP_IPV6=y
CONFIG_LWIP_IPV6_AUTOCONFIG=y
CONFIG_LWIP_IPV6_NUM_ADDRESSES=8
CONFIG_LWIP_TCPIP_CORE_LOCKING=y
CONFIG_LWIP_CHECK_THREAD_SAFETY=y
CONFIG_LWIP_HOOK_IP6_ROUTE_DEFAULT=y
CONFIG_LWIP_HOOK_ND6_GET_GW_DEFAULT=y
# Thread must choose the source from its mesh-local/on-mesh IPv6 addresses.
CONFIG_LWIP_HOOK_IP6_SELECT_SRC_ADDR_DEFAULT=y
CONFIG_LWIP_PPP_SUPPORT=n
CONFIG_LWIP_IPV4_NAPT=n

# BLE peripheral advertisement and GATT server preserve Matter commissioning.
# The Arduino BLE library is unused; native IDF NimBLE remains enabled.
CONFIG_BT_ENABLED=y
CONFIG_BT_CONTROLLER_ENABLED=y
CONFIG_ESP_COEX_SW_COEXIST_ENABLE=y
CONFIG_BT_NIMBLE_ENABLED=y
CONFIG_BT_BLUEDROID_ENABLED=n
CONFIG_ENABLE_CHIPOBLE=y
# Arduino owns BLE memory reclamation, matching the deployed SDK policy.
CONFIG_USE_BLE_ONLY_FOR_COMMISSIONING=n
CONFIG_CHIPOBLE_SINGLE_CONNECTION=y
CONFIG_CHIPOBLE_ENABLE_ADVERTISING_AUTOSTART=0
CONFIG_CHIP_ENABLE_PAIRING_AUTOSTART=n
CONFIG_ENABLE_ESP32_BLE_CONTROLLER=n
CONFIG_BT_NIMBLE_ROLE_CENTRAL=n
CONFIG_BT_NIMBLE_ROLE_OBSERVER=n
CONFIG_BT_NIMBLE_GATT_CLIENT=n
CONFIG_BT_NIMBLE_ROLE_PERIPHERAL=y
CONFIG_BT_NIMBLE_ROLE_BROADCASTER=y
CONFIG_BT_NIMBLE_GATT_SERVER=y
CONFIG_BT_NIMBLE_SECURITY_ENABLE=y
CONFIG_BT_NIMBLE_SM_LEGACY=y
CONFIG_BT_NIMBLE_SM_SC=y
CONFIG_BT_NIMBLE_SM_SC_DEBUG_KEYS=n
CONFIG_BT_NIMBLE_LL_CFG_FEAT_LE_ENCRYPTION=y
CONFIG_BT_NIMBLE_HOST_TASK_STACK_SIZE=5120
CONFIG_BT_NIMBLE_MAX_CONNECTIONS=3
CONFIG_BT_NIMBLE_ATT_PREFERRED_MTU=256
CONFIG_BT_NIMBLE_MSYS_1_BLOCK_COUNT=24
CONFIG_BT_NIMBLE_MSYS_2_BLOCK_COUNT=24
CONFIG_BT_NIMBLE_BLUFI_ENABLE=n
CONFIG_BT_NIMBLE_DTM_MODE_TEST=n
CONFIG_BT_NIMBLE_PROX_SERVICE=n
CONFIG_BT_NIMBLE_ANS_SERVICE=n
CONFIG_BT_NIMBLE_CTS_SERVICE=n
CONFIG_BT_NIMBLE_HTP_SERVICE=n
CONFIG_BT_NIMBLE_IPSS_SERVICE=n
CONFIG_BT_NIMBLE_TPS_SERVICE=n
CONFIG_BT_NIMBLE_IAS_SERVICE=n
CONFIG_BT_NIMBLE_LLS_SERVICE=n
CONFIG_BT_NIMBLE_SPS_SERVICE=n
CONFIG_BT_NIMBLE_HR_SERVICE=n
CONFIG_BT_NIMBLE_HID_SERVICE=n
CONFIG_BT_NIMBLE_BAS_SERVICE=n
CONFIG_BT_NIMBLE_DIS_SERVICE=n
CONFIG_BT_NIMBLE_GAP_SERVICE=y

# Matter crypto: retain the native implementation and required primitives.
# No replacement of PASE/CASE, Thread, RNG, certificate checks, or key storage.
CONFIG_MBEDTLS_HKDF_C=y
CONFIG_MBEDTLS_CMAC_C=y
CONFIG_MBEDTLS_AES_C=y
CONFIG_MBEDTLS_CCM_C=y
CONFIG_MBEDTLS_ECP_C=y
CONFIG_MBEDTLS_ECDH_C=y
CONFIG_MBEDTLS_ECDSA_C=y
CONFIG_MBEDTLS_ECP_DP_SECP256R1_ENABLED=y
CONFIG_MBEDTLS_PSK_MODES=y
CONFIG_MBEDTLS_KEY_EXCHANGE_PSK=y
CONFIG_MBEDTLS_KEY_EXCHANGE_ECJPAKE=y
CONFIG_MBEDTLS_ECJPAKE_C=y
CONFIG_MBEDTLS_SSL_PROTO_DTLS=y
CONFIG_SECURITY_TEST_MODE=n
CONFIG_TEST_EVENT_TRIGGER_ENABLED=n
# Arduino's override uses the SDK base provider salt/iteration. Keep its
# bootstrap data until a pre-start custom provider is implemented and tested.
CONFIG_ENABLE_TEST_SETUP_PARAMS=y
CONFIG_BUILD_CHIP_TESTS=n
CONFIG_ENABLE_CHIP_CONTROLLER_BUILD=n
CONFIG_ENABLE_CHIP_SHELL=n
CONFIG_ENABLE_THREAD_TELEMETRY=n
CONFIG_ENABLE_THREAD_TELEMETRY_FULL=n
CONFIG_ENABLE_ESP_DIAGNOSTICS=n
CONFIG_ENABLE_ESP_INSIGHTS_TRACE=n
CONFIG_ENABLE_ESP_INSIGHTS_SYSTEM_STATS=n

# Reduce compiled SDK text/log strings; retain application USB diagnostics.
CONFIG_ARDUHAL_LOG_DEFAULT_LEVEL_NONE=y
CONFIG_LOG_DEFAULT_LEVEL_NONE=y
CONFIG_LOG_MAXIMUM_EQUALS_DEFAULT=y
CONFIG_LOG_DYNAMIC_LEVEL_CONTROL=n
CONFIG_CHIP_LOG_DEFAULT_LEVEL_NONE=y
CONFIG_CHIP_CONFIG_IM_PRETTY_PRINT=n
CONFIG_BT_NIMBLE_LOG_LEVEL_NONE=y
CONFIG_BT_NIMBLE_PRINT_ERR_NAME=n

# Explicit Matter cluster allowlist: root security/commissioning, Thread
# diagnostics, fan, native on/off light/plugin, light mode, and their mandatory
# Identify/Groups/Scenes dependencies. Values come from installed1.5.1 SDK.
CONFIG_SUPPORT_ACCESS_CONTROL_CLUSTER=y
CONFIG_SUPPORT_ACCOUNT_LOGIN_CLUSTER=n
CONFIG_SUPPORT_ACTIONS_CLUSTER=n
CONFIG_SUPPORT_ACTIVATED_CARBON_FILTER_MONITORING_CLUSTER=n
CONFIG_SUPPORT_ADMINISTRATOR_COMMISSIONING_CLUSTER=y
CONFIG_SUPPORT_AIR_QUALITY_CLUSTER=n
CONFIG_SUPPORT_APPLICATION_BASIC_CLUSTER=n
CONFIG_SUPPORT_APPLICATION_LAUNCHER_CLUSTER=n
CONFIG_SUPPORT_AUDIO_OUTPUT_CLUSTER=n
CONFIG_SUPPORT_BASIC_INFORMATION_CLUSTER=y
CONFIG_SUPPORT_BINDING_CLUSTER=y
CONFIG_SUPPORT_BOOLEAN_STATE_CLUSTER=n
CONFIG_SUPPORT_BOOLEAN_STATE_CONFIGURATION_CLUSTER=n
CONFIG_SUPPORT_BRIDGED_DEVICE_BASIC_INFORMATION_CLUSTER=n
CONFIG_SUPPORT_CAMERA_AV_SETTINGS_USER_LEVEL_MANAGEMENT_CLUSTER=n
CONFIG_SUPPORT_CAMERA_AV_STREAM_MANAGEMENT_CLUSTER=n
CONFIG_SUPPORT_CARBON_DIOXIDE_CONCENTRATION_MEASUREMENT_CLUSTER=n
CONFIG_SUPPORT_CARBON_MONOXIDE_CONCENTRATION_MEASUREMENT_CLUSTER=n
CONFIG_SUPPORT_CHANNEL_CLUSTER=n
CONFIG_SUPPORT_CHIME_CLUSTER=n
CONFIG_SUPPORT_CLOSURE_CONTROL_CLUSTER=n
CONFIG_SUPPORT_CLOSURE_DIMENSION_CLUSTER=n
CONFIG_SUPPORT_COLOR_CONTROL_CLUSTER=y
CONFIG_SUPPORT_COMMISSIONER_CONTROL_CLUSTER=n
CONFIG_SUPPORT_COMMODITY_METERING_CLUSTER=n
CONFIG_SUPPORT_COMMODITY_PRICE_CLUSTER=n
CONFIG_SUPPORT_COMMODITY_TARIFF_CLUSTER=n
CONFIG_SUPPORT_CONTENT_LAUNCHER_CLUSTER=n
CONFIG_SUPPORT_CONTENT_CONTROL_CLUSTER=n
CONFIG_SUPPORT_CONTENT_APP_OBSERVER_CLUSTER=n
CONFIG_SUPPORT_DESCRIPTOR_CLUSTER=y
CONFIG_SUPPORT_DEVICE_ENERGY_MANAGEMENT_CLUSTER=n
CONFIG_SUPPORT_DEVICE_ENERGY_MANAGEMENT_MODE_CLUSTER=n
CONFIG_SUPPORT_DIAGNOSTIC_LOGS_CLUSTER=n
CONFIG_SUPPORT_DISHWASHER_ALARM_CLUSTER=n
CONFIG_SUPPORT_DISHWASHER_MODE_CLUSTER=n
CONFIG_SUPPORT_ELECTRICAL_GRID_CONDITIONS_CLUSTER=n
CONFIG_SUPPORT_GROUPCAST_CLUSTER=n
CONFIG_SUPPORT_METER_IDENTIFICATION_CLUSTER=n
CONFIG_SUPPORT_MICROWAVE_OVEN_MODE_CLUSTER=n
CONFIG_SUPPORT_DOOR_LOCK_CLUSTER=n
CONFIG_SUPPORT_ECOSYSTEM_INFORMATION_CLUSTER=n
CONFIG_SUPPORT_ELECTRICAL_ENERGY_MEASUREMENT_CLUSTER=n
CONFIG_SUPPORT_ELECTRICAL_POWER_MEASUREMENT_CLUSTER=n
CONFIG_SUPPORT_ENERGY_EVSE_CLUSTER=n
CONFIG_SUPPORT_ENERGY_EVSE_MODE_CLUSTER=n
CONFIG_SUPPORT_ETHERNET_NETWORK_DIAGNOSTICS_CLUSTER=n
CONFIG_SUPPORT_ENERGY_PREFERENCE_CLUSTER=n
CONFIG_SUPPORT_FAN_CONTROL_CLUSTER=y
CONFIG_SUPPORT_FAULT_INJECTION_CLUSTER=n
CONFIG_SUPPORT_FIXED_LABEL_CLUSTER=n
CONFIG_SUPPORT_FORMALDEHYDE_CONCENTRATION_MEASUREMENT_CLUSTER=n
CONFIG_SUPPORT_GENERAL_COMMISSIONING_CLUSTER=y
CONFIG_SUPPORT_GENERAL_DIAGNOSTICS_CLUSTER=y
CONFIG_SUPPORT_GROUPS_CLUSTER=y
CONFIG_SUPPORT_HEPA_FILTER_MONITORING_CLUSTER=n
CONFIG_SUPPORT_GROUP_KEY_MANAGEMENT_CLUSTER=y
CONFIG_SUPPORT_ICD_MANAGEMENT_CLUSTER=n
CONFIG_SUPPORT_IDENTIFY_CLUSTER=y
CONFIG_SUPPORT_JOINT_FABRIC_DATASTORE_CLUSTER=n
CONFIG_SUPPORT_JOINT_FABRIC_ADMINISTRATOR_CLUSTER=n
CONFIG_SUPPORT_KEYPAD_INPUT_CLUSTER=n
CONFIG_SUPPORT_LAUNDRY_WASHER_MODE_CLUSTER=n
CONFIG_SUPPORT_LEVEL_CONTROL_CLUSTER=y
CONFIG_SUPPORT_LOCALIZATION_CONFIGURATION_CLUSTER=n
CONFIG_SUPPORT_LOW_POWER_CLUSTER=n
CONFIG_SUPPORT_MEDIA_INPUT_CLUSTER=n
CONFIG_SUPPORT_MEDIA_PLAYBACK_CLUSTER=n
CONFIG_SUPPORT_MICROWAVE_OVEN_CONTROL_CLUSTER=n
CONFIG_SUPPORT_MESSAGES_CLUSTER=n
CONFIG_SUPPORT_MODE_SELECT_CLUSTER=y
CONFIG_SUPPORT_NETWORK_COMMISSIONING_CLUSTER=y
CONFIG_SUPPORT_NITROGEN_DIOXIDE_CONCENTRATION_MEASUREMENT_CLUSTER=n
CONFIG_SUPPORT_PUSH_AV_STREAM_TRANSPORT_CLUSTER=n
CONFIG_SUPPORT_SAMPLE_MEI_CLUSTER=n
CONFIG_SUPPORT_OCCUPANCY_SENSING_CLUSTER=n
CONFIG_SUPPORT_ON_OFF_CLUSTER=y
CONFIG_SUPPORT_POWER_TOPOLOGY_CLUSTER=n
CONFIG_SUPPORT_OPERATIONAL_CREDENTIALS_CLUSTER=y
CONFIG_SUPPORT_OPERATIONAL_STATE_CLUSTER=n
CONFIG_SUPPORT_OPERATIONAL_STATE_OVEN_CLUSTER=n
CONFIG_SUPPORT_OPERATIONAL_STATE_RVC_CLUSTER=n
CONFIG_SUPPORT_OTA_SOFTWARE_UPDATE_PROVIDER_CLUSTER=n
CONFIG_SUPPORT_OTA_SOFTWARE_UPDATE_REQUESTOR_CLUSTER=n
CONFIG_SUPPORT_OVEN_MODE_CLUSTER=n
CONFIG_SUPPORT_OZONE_CONCENTRATION_MEASUREMENT_CLUSTER=n
CONFIG_SUPPORT_PM10_CONCENTRATION_MEASUREMENT_CLUSTER=n
CONFIG_SUPPORT_PM1_CONCENTRATION_MEASUREMENT_CLUSTER=n
CONFIG_SUPPORT_PM2_5_CONCENTRATION_MEASUREMENT_CLUSTER=n
CONFIG_SUPPORT_POWER_SOURCE_CLUSTER=n
CONFIG_SUPPORT_POWER_SOURCE_CONFIGURATION_CLUSTER=n
CONFIG_SUPPORT_PUMP_CONFIGURATION_AND_CONTROL_CLUSTER=n
CONFIG_SUPPORT_RADON_CONCENTRATION_MEASUREMENT_CLUSTER=n
CONFIG_SUPPORT_REFRIGERATOR_ALARM_CLUSTER=n
CONFIG_SUPPORT_REFRIGERATOR_AND_TEMPERATURE_CONTROLLED_CABINET_MODE_CLUSTER=n
CONFIG_SUPPORT_RVC_CLEAN_MODE_CLUSTER=n
CONFIG_SUPPORT_RVC_RUN_MODE_CLUSTER=n
CONFIG_SUPPORT_SCENES_CLUSTER=y
CONFIG_SUPPORT_SERVICE_AREA_CLUSTER=n
CONFIG_SUPPORT_SMOKE_CO_ALARM_CLUSTER=n
CONFIG_SUPPORT_SOFTWARE_DIAGNOSTICS_CLUSTER=n
CONFIG_SUPPORT_SOIL_MEASUREMENT_CLUSTER=n
CONFIG_SUPPORT_SWITCH_CLUSTER=n
CONFIG_SUPPORT_TARGET_NAVIGATOR_CLUSTER=n
CONFIG_SUPPORT_TEMPERATURE_CONTROL_CLUSTER=n
CONFIG_SUPPORT_THERMOSTAT_CLUSTER=n
CONFIG_SUPPORT_THERMOSTAT_USER_INTERFACE_CONFIGURATION_CLUSTER=n
CONFIG_SUPPORT_THREAD_BORDER_ROUTER_MANAGEMENT_CLUSTER=n
CONFIG_SUPPORT_THREAD_NETWORK_DIAGNOSTICS_CLUSTER=y
CONFIG_SUPPORT_THREAD_NETWORK_DIRECTORY_CLUSTER=n
CONFIG_SUPPORT_TIME_FORMAT_LOCALIZATION_CLUSTER=n
CONFIG_SUPPORT_TIME_SYNCHRONIZATION_CLUSTER=n
CONFIG_SUPPORT_TIMER_CLUSTER=n
CONFIG_SUPPORT_TLS_CERTIFICATE_MANAGEMENT_CLUSTER=n
CONFIG_SUPPORT_TLS_CLIENT_MANAGEMENT_CLUSTER=n
CONFIG_SUPPORT_TVOC_CONCENTRATION_MEASUREMENT_CLUSTER=n
CONFIG_SUPPORT_UNIT_LOCALIZATION_CLUSTER=n
CONFIG_SUPPORT_UNIT_TESTING_CLUSTER=n
CONFIG_SUPPORT_USER_LABEL_CLUSTER=n
CONFIG_SUPPORT_VALVE_CONFIGURATION_AND_CONTROL_CLUSTER=n
CONFIG_SUPPORT_WAKE_ON_LAN_CLUSTER=n
CONFIG_SUPPORT_LAUNDRY_WASHER_CONTROLS_CLUSTER=n
CONFIG_SUPPORT_LAUNDRY_DRYER_CONTROLS_CLUSTER=n
CONFIG_SUPPORT_WEB_RTC_TRANSPORT_PROVIDER_CLUSTER=n
CONFIG_SUPPORT_WEB_RTC_TRANSPORT_REQUESTOR_CLUSTER=n
CONFIG_SUPPORT_WIFI_NETWORK_DIAGNOSTICS_CLUSTER=n
CONFIG_SUPPORT_WIFI_NETWORK_MANAGEMENT_CLUSTER=n
CONFIG_SUPPORT_WINDOW_COVERING_CLUSTER=n
CONFIG_SUPPORT_WATER_HEATER_MANAGEMENT_CLUSTER=n
CONFIG_SUPPORT_WATER_HEATER_MODE_CLUSTER=n
CONFIG_SUPPORT_ZONE_MANAGEMENT_CLUSTER=n
```
